## prj.conf
```kconfig
# SPDX-License-Identifier: Apache-2.0

# Habilita la consola UART para printk/printf
# CONFIG_SERIAL=y
# CONFIG_CONSOLE=y
# CONFIG_UART_CONSOLE=y

# SEGGER RTT console – streams printk/LOG output through the J-Link debug
# connection, no separate UART/USB needed.
CONFIG_UART_CONSOLE=n
CONFIG_RTT_CONSOLE=y
CONFIG_USE_SEGGER_RTT=y
```

## src/main.c
```c
/*
 * SPDX-License-Identifier: Apache-2.0
 */

#include <zephyr/kernel.h>

int main(void)
{
	printk("Hello World! %s\n", CONFIG_BOARD);

	while (1) {
		k_sleep(K_SECONDS(1));
		printk("alive\n");
	}

	return 0;
}
```
