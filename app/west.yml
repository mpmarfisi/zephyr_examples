## app/west.yml
```yaml
manifest:
  remotes:
    - name: zephyrproject-rtos
      url-base: https://github.com/zephyrproject-rtos
  projects:
    - name: zephyr
      remote: zephyrproject-rtos
      revision: v3.6.0
      import: true
  self:
    path: app

# The west manifest file for upstream Zephyr.
#
# The per-installation west configuration file, .west/config, sets the
# path to the project containing this file in the [manifest] section's
# "path" variable.
#
# You are free to create your own manifest files and put them in any
# repository you want, to create your own custom Zephyr installations.
# For example, you could create a manifest file in your own out of
# tree application directory, which would pull this zephyr repository
# in as an ordinary project.
#
# You can pass your manifest repositories to west init when creating a
# new Zephyr installation. See the west documentation for more
# information.

manifest:
  defaults:
    remote: upstream

  remotes:
    - name: upstream
      url-base: https://github.com/zephyrproject-rtos
    - name: babblesim
      url-base: https://github.com/BabbleSim

  group-filter: [-babblesim, -optional]

  #
  # Please add items below based on alphabetical order
  projects:
    - name: zephyr
      revision: v3.6.0
      west-commands: scripts/west-commands.yml
    - name: cmsis
      revision: 4b96cbb174678dcd3ca86e11e1f24bc5f8726da0
      path: modules/hal/cmsis
      groups:
        - hal
    - name: hal_nordic
      revision: dce8519f7da37b0a745237679fd3f88250b495ff
      path: modules/hal/nordic
      groups:
        - hal

  self:
    path: app
```

## west.yml
```yaml
manifest:
  remotes:
    - name: zephyrproject-rtos
      url-base: https://github.com/zephyrproject-rtos

  projects:
    - name: zephyr
      remote: zephyrproject-rtos
      revision: v4.3.0
      import:
        # By using name-allowlist we can clone only the modules that are
        # strictly needed by the application.
        name-allowlist:
          - cmsis_6    # required by the ARM port for Cortex-M
          - hal_nordic # required by the custom_plank board (Nordic based)
          - segger
    # - name: cmsis
    #   revision: 4b96cbb174678dcd3ca86e11e1f24bc5f8726da0
    #   path: modules/hal/cmsis
    #   groups:
    #     - hal
    # - name: hal_nordic
    #   revision: dce8519f7da37b0a745237679fd3f88250b495ff
    #   path: modules/hal/nordic
    #   groups:
    #     - hal
```
